## conf/local.conf
```bitbake
CONF_VERSION = "1"

MACHINE ??= 'imx7-cm'
DISTRO ?= 'tcht-cm'
PACKAGE_CLASSES ?= 'package_rpm'
EXTRA_IMAGE_FEATURES ?= "debug-tweaks"
USER_CLASSES ?= "buildstats image-mklibs image-prelink"
PATCHRESOLVE = "noop"

BOARD ?= "cm_boardv2"
GITREV ?= "UNKNOWN"

BB_DISKMON_DIRS ??= "\
    STOPTASKS,${TMPDIR},1G,100K \
    STOPTASKS,${DL_DIR},1G,100K \
    STOPTASKS,${SSTATE_DIR},1G,100K \
    STOPTASKS,/tmp,100M,100K \
    ABORT,${TMPDIR},100M,1K \
    ABORT,${DL_DIR},100M,1K \
    ABORT,${SSTATE_DIR},100M,1K \
    ABORT,/tmp,10M,1K"
PACKAGECONFIG_append_pn-qemu-system-native = " sdl"
PACKAGECONFIG_append_pn-sqlite3 = " readline"

DL_DIR ?= "${BSPDIR}/downloads/"
ACCEPT_FSL_EULA = "1"

BITBUCKET_USER ?= "UNKNOWN"
BITBUCKET_PASS ?= "UNKNOWN"

LINUX_USER ?= "ne"
LINUX_PASS ?= "NetEng2025"

HOSTTOOLS += " curl base64"

HOSTNAME_Y ?= "cm"

PACKAGECONFIG_append_pn-networkmanager = " modemmanager ppp resolvconf"

# Skip connectivity checks
CONNECTIVITY_CHECK_URIS = ""

IMAGE_INSTALL_append = " "
```
